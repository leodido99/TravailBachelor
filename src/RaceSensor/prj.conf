## CMakeLists.txt
```
# Create following http://docs.zephyrproject.org/application/application.html

# Board used
set(BOARD sodaq_one_v3)

# Include zephyr
include($ENV{ZEPHYR_BASE}/cmake/app/boilerplate.cmake NO_POLICY_SCOPE)
project(NONE)

# Application source files
target_sources(app PRIVATE
	       	   src/main.c
	       	   src/debug.c
	       	   src/race_sensor_manager.c
	       	   src/race_sensor_shell.c
	       	   src/drivers/LSM303AGR.c
	           src/drivers/RN2483_lora.c
	           src/drivers/UBloxEVA8M.c
	           src/drivers/leds.c	  
	           src/heart_rate.c
	           src/cadence.c         
	           )

# Include directories
zephyr_include_directories(
	src/
	src/drivers
)
```

## prj.conf
```kconfig
CONFIG_SYS_LOG=y
CONFIG_SYS_LOG_DEFAULT_LEVEL=3
CONFIG_SYS_LOG_I2C_LEVEL=3
#CONFIG_SYS_LOG_GPIO_SAM0_LEVEL=4
#CONFIG_SYS_LOG_EXTI_SAM0_LEVEL=4

CONFIG_OBJECT_TRACING=y
CONFIG_THREAD_MONITOR=y
CONFIG_MPU_STACK_GUARD=y

CONFIG_CONSOLE_SHELL=y

#CONFIG_ASSERT=y
```

## src/main.c
```c
/** 
 * @file main.c
 * @brief Entry point
 *
 * Entry point for the RaceSensor application
 *
 * @author Léonard Bise
 * @date   Jul 23, 2018
 */

#include <kernel.h>
#include <shell/shell.h>

#include "debug.h"
/**
 * Set debug
 */
#define DEBUG DEBUG_MAIN

#include "race_sensor_manager.h"
#include "RN2483_lora.h"
#include "UBloxEVA8M.h"
#include "leds.h"
#include "race_sensor_shell.h"

/**
 * Delay used to make the LED blink on fatal error
 */
#define FATAL_ERR_LED_DELAY 100

#define RACE_SENSOR_SHELL "race-sensor"

/**
 * Function called in case of a fatal error
 */
static void fatal_error(char *msg)
{
	DBG_PRINTK("FATAL ERROR! %s\n", msg);

	while(1) {
		leds_set(LED_RED, true);
		k_sleep(FATAL_ERR_LED_DELAY);
		leds_set(LED_RED, false);
		k_sleep(FATAL_ERR_LED_DELAY);
	}
}

static struct shell_cmd commands[] = {
	{ "set_lora_sf", race_sensor_shell_set_lora_sf, "<sf>\n\nSets the LoRa spreading factor (sf7 to sf12)"},
	{ "set_lora_pwr", race_sensor_shell_set_lora_pwr, "<pwr>\n\nSets the LoRa power output (-3 to 15)"},
	{ "set_msg_interval", race_sensor_shell_set_msg_interval , "<ms>\n\nSets the sensor message interval" },
	{ NULL, NULL, NULL }
};

void main(void)
{
	int err;

#if defined(CONFIG_OBJECT_TRACING) && defined(CONFIG_THREAD_MONITOR)
	dbg_print_threads();
#endif

	err = leds_init();
	if (err < 0) {
		fatal_error("Cannot init LEDs");
	}

	DBG_PRINTK("%s: Initializing race sensor manager\n", __func__);
	err = race_sensor_mngr_init();
	if (err < 0) {
		fatal_error("Cannot init race sensor manager");
	}

	DBG_PRINTK("%s: Starting race sensor manager\n", __func__);
	err = race_sensor_mngr_start();
	if (err < 0) {
		fatal_error("Cannot start race sensor manager");
	}

	DBG_PRINTK("%s: Starting\n", __func__);

	/* Setup race sensor shell */
	SHELL_REGISTER(RACE_SENSOR_SHELL, commands);
	shell_register_default_module(RACE_SENSOR_SHELL);

}
```

## src/cadence.c
```c
/**
 * @file cadence.c
 * @brief Cadence module
 *
 * Retrieves data from the accelerometer
 * and detects when a step is made
 *
 * @author Léonard Bise
 * @date   Jul 26, 2018
 */
#include "cadence.h"

#include <gpio.h>
#include <stdio.h>

#include "LSM303AGR.h"
#include "leds.h"
#include "sensor_config.h"

#include "debug.h"

#define DEBUG DEBUG_CADENCE

struct cadence {
	struct gpio_callback int1_cb;
	int step_cnt;
	s32_t last_step_time;
	s64_t start_time;
};

struct cadence cadence_priv = {
	.last_step_time = 0
};

extern const k_tid_t cadence_sampling_thread_id;

/* See LSM303AGR 18000 / 64 * 4 / 1000 = 1.125g */
#define CADENCE_THRESHOLD 18000

/* Minimum time between two steps
 * For fastest runners cadence is 200
 * -> 60000 / 200 = 300ms */
#define CADENCE_MIN_TIME_BETWEEN_STEPS K_MSEC(300)

/**
 * Stack size allocated for the cadence sampling thread
 */
#define CADENCE_STACK_SIZE 1024

/**
 * Thread priority for the cadence sampling thread
 */
#define CADENCE_PRIORITY 14

/* 1 second of samples */
#define CADENCE_NB_SAMPLE 20
/* Interval between two samples */
#define CADENCE_SAMPLING_INTERVAL K_MSEC(50)

struct cadence_sample_t {
	int16_t sample;
};

struct cadence_sampling_t {
	uint16_t nb_samples;
	uint8_t nb_occurances;
	bool counted;
	struct cadence_sample_t samples[CADENCE_NB_SAMPLE];
	struct cadence_sample_t previous_sample;
};

struct cadence_sampling_t cadence_sampling = {
	.nb_samples = 0,
	.nb_occurances = 0,
	.counted = false
};

#ifdef CADENCE_IRQ
void cadence_gpio_callback(struct device *port, struct gpio_callback *cb, u32_t pins)
{
	new_step();
}

static int setup_gpio_irq(const char* device, int pin)
{
	struct device *dev;
	int err;

	dev = device_get_binding(device);
	if (!dev) {
		DBG_PRINTK("%s: Binding to gpio failed\n", __func__);
		return CADENCE_BINDING_FAILED;
	}

	gpio_init_callback(&cadence_priv.int1_cb, cadence_gpio_callback, BIT(pin));

	err = gpio_add_callback(dev, &cadence_priv.int1_cb);
	if (err < 0) {
		DBG_PRINTK("%s: Cannot add callback\n", __func__);
		return err;
	}

	/* Interruption on rising edge */
	err = gpio_pin_configure(dev, pin, (GPIO_DIR_IN | GPIO_INT |
			 	 GPIO_INT_EDGE | GPIO_INT_ACTIVE_HIGH));
	if (err < 0) {
		DBG_PRINTK("%s: Cannot configure gpio pin %d", __func__, pin);
		return err;
	}

	err = gpio_pin_enable_callback(dev, pin);
	if (err < 0) {
		DBG_PRINTK("%s: Cannot add callback\n", __func__);
		return err;
	}

	return 0;
}
#endif

static void new_step(void)
{
	if (cadence_priv.start_time == 0) {
		cadence_priv.start_time = k_uptime_get();
	}

	printk("step!\n");

	if (!cadence_priv.last_step_time ||
			(k_uptime_get_32() - cadence_priv.last_step_time) >= CADENCE_MIN_TIME_BETWEEN_STEPS) {
		cadence_priv.step_cnt++;
	}

	cadence_priv.last_step_time = k_uptime_get_32();
}

static int get_steps(void)
{
	return cadence_priv.step_cnt;
}

static int fetch_sample(int16_t *sample)
{
	int err;

	/* TODO Fine tune step detection (depends on
	 * sensor position etc...) */
	err = lsm303agr_get_z_acceleration(sample);
	if (err < 0) {
		return err;
	}

	return 0;
}

static bool is_overthreshold(struct cadence_sample_t sample)
{
	/* TODO Threshold negative? */
	return (sample.sample > CADENCE_THRESHOLD);
}

static int process_samples(struct cadence_sampling_t *sampling)
{
	int i;

	if (!sampling) {
		DBG_PRINTK("Bad parameters\n");
		return -EINVAL;
	}

	/* Detect step */
	for (i = 0; i < sampling->nb_samples; i++) {
		if (is_overthreshold(sampling->samples[i])) {
			/* Only count once the sample is over the threshold
			 * signal must come back under it to be counted again
			 */
			if (!sampling->counted) {
				new_step();
				sampling->counted = true;
			}
		} else {
			sampling->counted = false;
		}
	}

	return 0;
}

static void cadence_sampling_thread(void *arg1, void *arg2, void *arg3)
{
	struct cadence_sampling_t *sampling = arg1;

	DBG_PRINTK("Cadence Sampling Thread\n");

	while (1) {
		/* Get sample */
		if (fetch_sample(&sampling->samples[sampling->nb_samples].sample) < 0) {
			DBG_PRINTK("Cannot get sample\n");
			continue;
		}

		sampling->nb_samples++;

		if (sampling->nb_samples == CADENCE_NB_SAMPLE) {
			process_samples(sampling);
			sampling->nb_samples = 0;
			//DBG_PRINTK("nb steps: %d\n", get_steps());
		}

		k_sleep(CADENCE_SAMPLING_INTERVAL);
	}
}

static int configure_lsm303agr(const char* device)
{
	int err;

	/* Initialize the LSM303AGR module */
	err = lsm303agr_init(device);
	if (err) {
		DBG_PRINTK("%s: Can't init LSM303AGR %d\n", __func__, err);
		return CADENCE_CONFIGURATION_ERROR;
	}

	/* Enable the accelerometer */
	err = lsm303agr_accel_enable(LSM303AGR_NORMAL_MODE, LSM303AGR_HIGH_RES_100HZ, false, (LSM303AGR_Z_AXIS | LSM303AGR_Y_AXIS | LSM303AGR_X_AXIS));
	if (err) {
		DBG_PRINTK("%s: Can't enable accelerometer %d\n", __func__, err);
		return CADENCE_CONFIGURATION_ERROR;
	}

#ifdef CADENCE_IRQ
	/* Configure interruption */
	err = lsm303agr_configure_interrupt1(LSM303AGR_INT_AND_COMBINATION,
			LSM303AGR_INT_DIR_Z_HIGH);
	if (err < 0) {
		DBG_PRINTK("%s: Cannot configure interrupt 1", __func__);
		return CADENCE_CONFIGURATION_ERROR;
	}

	/* Set interrupt threshold */
	err = lsm303agr_set_interrupt_threshold(ACCELEROMETER_Z_THRESHOLD);
	if (err < 0) {
		DBG_PRINTK("%s: Cannot set threshold", __func__);
	}

	/* Set duration of the interrupt */
	err = lsm303agr_set_interrupt_duration(ACCELEROMETER_INT_DURATION);
	if (err < 0) {
		DBG_PRINTK("%s: Cannot set duration", __func__);
	}

	/* Enable interrupt */
	err = lsm303agr_enable_interrupt(LSM303AGR_INT_AOI1);
	if (err < 0) {
		DBG_PRINTK("%s: Cannot enable interrupt 1", __func__);
		return CADENCE_CONFIGURATION_ERROR;
	}
#endif

	return 0;
}

int cadence_init(const char* device, const char *irq_device, int irq_pin) {
	int err;

	err = configure_lsm303agr(device);
	if (err < 0) {
		return err;
	}

#ifdef CADENCE_IRQ
	err = setup_gpio_irq(irq_device, irq_pin);
	if (err < 0) {
		return err;
	}
#endif

	k_thread_start(cadence_sampling_thread_id);

	return 0;
}

u8_t cadence_get(void)
{
	u8_t spm;
	s64_t elapsed_s = (k_uptime_get() - cadence_priv.start_time) / 1000;

	spm = (60 * cadence_priv.step_cnt) / elapsed_s;

	DBG_PRINTK("%s: PPM=%d steps=%d elapsed=%lld s\n", __func__, spm, cadence_priv.step_cnt, elapsed_s);

	cadence_priv.step_cnt = 0;
	cadence_priv.start_time = 0;

	return spm;
}

K_THREAD_DEFINE(cadence_sampling_thread_id, CADENCE_STACK_SIZE, cadence_sampling_thread, &cadence_sampling, NULL, NULL, CADENCE_PRIORITY, 0, K_FOREVER);
```

## src/cadence.h
```c
/**
 * @file cadence.h
 * @brief Cadence module
 *
 * Retrieves data from the accelerometer
 * and detects when a step is made
 *
 * @author Léonard Bise
 * @date   Jul 26, 2018
 */

#ifndef SRC_CADENCE_H_
#define SRC_CADENCE_H_

#include <zephyr.h>

#define CADENCE_SUCCESS 0
#define CADENCE_BINDING_FAILED -1
#define CADENCE_CONFIGURATION_ERROR -2

/**
 * Initialize the cadence module
 * @param device Device on which the LSM303AGR is connected
 * @param irq_device Device on which the IRQ is connected (GPIO port)
 * @param irq_pin Pin of the GPIO port on which IRQ is
 * @return 0 if success, negative errorno otherwise
 */
int cadence_init(const char* device, const char *irq_device, int irq_pin);

/**
 * Return the cadence in step per min
 * @return Cadence
 */
u8_t cadence_get(void);

#endif /* SRC_CADENCE_H_ */
```

## src/debug.h
```c
/** 
 * @file debug.h
 * @brief Debug module
 *
 * Provides debug functions
 *
 * @author Léonard Bise
 * @date   Jun 29, 2018
 */
#ifndef SRC_DEBUG_H_
#define SRC_DEBUG_H_

/* Modules */
#define DEBUG_MAIN 1
#define DEBUG_RACE_SENSOR_MNGR 1

/* Drivers */
#define DEBUG_RN2483_LORA 0
#define DEBUG_LSM303AGR 1
#define DEBUG_UBLOXEVA8M 0
#define DEBUG_LEDS 1
#define DEBUG_HR 1
#define DEBUG_CADENCE 1

#define DBG_PRINTK(fmt, ...) \
            do { if (DEBUG) printk(fmt, ## __VA_ARGS__); } while (0)

#if defined(CONFIG_OBJECT_TRACING) && defined(CONFIG_THREAD_MONITOR)
/**
 * Prints all the threads
 */
void dbg_print_threads(void);
#endif

#endif /* SRC_DEBUG_H_ */
```

## src/heart_rate.c
```c
/*
 * heart_rate.c
 *
 *  Created on: 17 Aug 2018
 *      Author: leonard.bise
 */

#include "heart_rate.h"

#include "debug.h"
#include <gpio.h>
#include <pinmux.h>

/**
 * Set debug
 */
#define DEBUG DEBUG_HR

struct heart_rate {
	struct device *gpio_dev;
	struct gpio_callback gpio_cb;
	int pin;
	int beat_cnt;
	s64_t start_time;
};

static struct heart_rate hr = {
	.beat_cnt = 0,
	.start_time = 0
};

void hr_gpio_callback(struct device *port, struct gpio_callback *cb, u32_t pins)
{
	if (hr.start_time == 0) {
		hr.start_time = k_uptime_get();
	}

	hr.beat_cnt++;
	DBG_PRINTK("beat!\n");
}

u8_t hr_get(void)
{
	u8_t bpm;
	s64_t elapsed_s = (k_uptime_get() - hr.start_time) / 1000;

	bpm = (60 * hr.beat_cnt) / elapsed_s;

	DBG_PRINTK("%s: BPM=%d beats=%d elapsed=%lld s\n", __func__, bpm, hr.beat_cnt, elapsed_s);

	hr.beat_cnt = 0;
	hr.start_time = 0;

	return bpm;
}

int hr_get_io(void)
{
	int value;
	int err;

	err = gpio_pin_read(hr.gpio_dev, hr.pin, &value);
	if (err < 0) {
		DBG_PRINTK("Cannot read IO");
		return HR_GPIO_ACCESSS_FAILED;
	}

	return value;
}

int hr_init(const char* device, int pin)
{
	int err;
	struct device *muxa;

	hr.pin = pin;

	DBG_PRINTK("HR device %s pin %d\n", device, hr.pin);

	/* Update pin configuration to be EXTINT */
	muxa = device_get_binding(CONFIG_PINMUX_SAM0_A_LABEL);
	if (!muxa) {
		DBG_PRINTK("%s: Binding to pinmux failed\n", __func__);
		return HR_BINDING_FAILED;
	}

	err = pinmux_pin_set(muxa, 11, PINMUX_FUNC_A);
	if (err < 0) {
		DBG_PRINTK("%s: Cannot change pin function\n", __func__);
		return err;
	}

	hr.gpio_dev = device_get_binding(device);
	if (!hr.gpio_dev) {
		DBG_PRINTK("%s: Binding to gpio failed\n", __func__);
		return HR_BINDING_FAILED;
	}

	gpio_init_callback(&hr.gpio_cb, hr_gpio_callback, BIT(hr.pin));

	err = gpio_add_callback(hr.gpio_dev, &hr.gpio_cb);
	if (err < 0) {
		DBG_PRINTK("%s: Cannot add callback\n", __func__);
		return err;
	}

	err = gpio_pin_configure(hr.gpio_dev, hr.pin, (GPIO_DIR_IN | GPIO_INT |
			 	 GPIO_INT_EDGE | GPIO_INT_ACTIVE_HIGH));
	if (err < 0) {
		DBG_PRINTK("%s: Cannot configure gpio pin %d", __func__, hr.pin);
		return err;
	}

	err = gpio_pin_enable_callback(hr.gpio_dev, hr.pin);
	if (err < 0) {
		DBG_PRINTK("%s: Cannot add callback\n", __func__);
		return err;
	}

	return HR_SUCCESS;
}
```

## src/heart_rate.h
```c
/**
 * @file heart_rate.h
 * @brief Heart Rate module
 *
 * Handles the IO associated with the Heart Rate module
 *
 * @author Léonard Bise
 * @date   Jul 23, 2018
 */

#ifndef SRC_HEART_RATE_H_
#define SRC_HEART_RATE_H_

#define HR_SUCCESS 0
#define HR_BINDING_FAILED -1
#define HR_GPIO_ACCESSS_FAILED -2

int hr_init(const char* device, int pin);



#endif /* SRC_HEART_RATE_H_ */
```

## src/packet_manager.c
```c
/** 
 * @file packet_manager.c
 * @brief Packet Manager module
 *
 * The Packet Manager module is responsible for periodically
 * creating and sending the Race Tracking Packet containing
 * the information about the competitor
 *
 * @author Léonard Bise
 * @date   Jul 23, 2018
 */

#include "packet_manager.h"

#include "debug.h"

#include "sensor_config.h"
#include "RN2483_lora.h"
#include "UBloxEVA8M.h"
#include "LSM303AGR.h"
#include "race_tracking_packet.h"
#include "leds.h"

#include <string.h>
#include <misc/byteorder.h>

/**
 * Set debug
 */
#define DEBUG DEBUG_PKT_MNGR

/**
 * Marker used to signal the beginning of the packet
 */
#define PKT_MANAGER_SYNC_MARKER 0xF0CACC1A

/**
 * Stack size allocated for the packet manager thread
 */
#define PKT_MANAGER_STACK_SIZE 1024

/**
 * Thread priority for the packet manager thread
 */
#define PKT_MANAGER_PRIORITY 10

/**
 * ID of the sensor
 */
#define PKT_MANAGER_SENSOR_ID 0xBEEF

/**
 * The interval between two thread execution
 */
#define PKT_MANAGER_THREAD_INTERVAL K_MSEC(5000)

/**
 * The minimum number of satellites we are waiting for during GPS fix
 */
#define PKT_MANAGER_GPS_FIX_NB_SV 4

/**
 * The fix type we are waiting for during GPS fix
 */
#define PKT_MANAGER_GPS_FIX_TYPE (UBLOXEVA8M_NAV_PVT_FIXTYPE_2D_FIX_MASK \
				| UBLOXEVA8M_NAV_PVT_FIXTYPE_3D_FIX_MASK)

/* The thread id for LoRa */
extern const k_tid_t packet_mngr_thread_id;

/* Semaphore used to wait for GPS updates */
K_SEM_DEFINE(pkt_mngr_gps_sem, 0, 1);

struct pkt_mngr_data {
	bool initialized;
	k_tid_t thread_id;
	struct k_thread *thread_data;
	struct k_sem *gps_sem;
	ubloxeva8m_nav_pvt_t last_pvt_msg;
	u16_t pkt_seq;
	u8_t heart_rate;
	u8_t cadence;
};

struct pkt_mngr_data pkt_mngr = {
	.initialized = false,
	.gps_sem = &pkt_mngr_gps_sem,
	.pkt_seq = 0,
	.heart_rate = 0,
	.cadence = 0
};

/**
 * Buffer used to hold a packet
 */
struct pkt_mngr_race_pkt pkt_buffer;

#ifdef DEBUG
static void print_nav_pvt_msg(char *txt, ubloxeva8m_nav_pvt_t* msg) {
	DBG_PRINTK("UBX-NAV-PVT: %d.%d.%d %02d:%02d:%02d:%03d validity=%d fixType=%d numSV=%d lat=%d lon=%d \n", msg->day, msg->month, msg->year, msg->hour, msg->minute, msg->seconds, msg->nano, msg->valid, msg->fixType, msg->numSV, msg->lat, msg->lon);
}
#endif

static void gps_msg_callback(ubloxeva8m_ubx_msg* msg)
{
	if (msg->class_id == UBLOXEVA8M_CLASS_NAV && msg->message_id == UBLOXEVA8M_MSG_NAV_PVT) {
		memcpy(&pkt_mngr.last_pvt_msg, msg->payload, sizeof(ubloxeva8m_nav_pvt_t));
		print_nav_pvt_msg("UBX-NAV-PVT: ", &pkt_mngr.last_pvt_msg);
		k_sem_give(pkt_mngr.gps_sem);
	}
}

static void wait_for_gps_update()
{
	/* Wait for new GPS message */
	k_sem_reset(pkt_mngr.gps_sem);
	k_sem_take(pkt_mngr.gps_sem, K_FOREVER);
}

static void get_timestamp(u8_t *buffer) {
	/* TODO */
}

static void wait_for_fix() {
	bool led_state = false;

	DBG_PRINTK("%s: Waiting for GPS fix...\n", __func__);

	do {
		wait_for_gps_update();
		leds_set(LED_GREEN, led_state);
		led_state = led_state ? false : true;
	} while(pkt_mngr.last_pvt_msg.numSV < PKT_MANAGER_GPS_FIX_NB_SV ||
		pkt_mngr.last_pvt_msg.fixType & PKT_MANAGER_GPS_FIX_TYPE);

	leds_set(LED_GREEN, true);

	DBG_PRINTK("%s: Found GPS fix Num SV=%d FixType=0x%x\n", __func__, pkt_mngr.last_pvt_msg.numSV, pkt_mngr.last_pvt_msg.fixType);
}

static int build_packet(struct pkt_mngr_race_pkt *packet)
{
	/* In order to have the most precise GPS position we
	 * wait for a new one */
	wait_for_gps_update();

	/* Data is transfered as big endian */
	packet->marker = sys_cpu_to_be32(PKT_MANAGER_SYNC_MARKER);

	packet->id = sys_cpu_to_be16(PKT_MANAGER_SENSOR_ID);

	/* TODO Byte order */
	get_timestamp(packet->timestamp);

	packet->status = 0;

	packet->counter = sys_cpu_to_be16(pkt_mngr.pkt_seq);
	pkt_mngr.pkt_seq++;

	packet->latitude = sys_cpu_to_be32(pkt_mngr.last_pvt_msg.lat);

	packet->longitude = sys_cpu_to_be32(pkt_mngr.last_pvt_msg.lon);

	packet->nb_sv = pkt_mngr.last_pvt_msg.numSV;

	packet->pdop = sys_cpu_to_be16(pkt_mngr.last_pvt_msg.pDOP);

	packet->heart_rate = pkt_mngr.heart_rate;

	packet->cadence = pkt_mngr.cadence;

	return PKT_MNGR_SUCCESS;
}

static void pkt_mngr_thread(void)
{
	DBG_PRINTK("%s: Enter thread\n", __func__);

	/* Before sending packets we are going to wait to have a good GPS fix
	 * in order to provide precise positions */
	wait_for_fix();

	while (1) {
		k_sleep(PKT_MANAGER_THREAD_INTERVAL);
		/* Build packet */
		if (build_packet(&pkt_buffer) < 0) {
			DBG_PRINTK("Couldn't build packet\n");
		}
		/* Send through LoRa */
		if (rn2483_lora_radio_tx((u8_t*)&pkt_buffer, sizeof(struct pkt_mngr_race_pkt))) {
			DBG_PRINTK("Couldn't send packet\n");
		}
	}
}

static int configure_lsm303agr(void)
{
	int err;

	/* Initialize the LSM303AGR module */
	err = lsm303agr_init(CONFIG_I2C_SAM0_SERCOM3_LABEL);
	if (err) {
		DBG_PRINTK("%s: Can't init LSM303AGR %d\n", __func__, err);
		return PKT_MNGR_ACCEL_DEVICE_FAILURE;
	}

	/* Enable the accelerometer */
	err = lsm303agr_accel_enable(LSM303AGR_NORMAL_MODE, LSM303AGR_HIGH_RES_100HZ, false, (LSM303AGR_Z_AXIS | LSM303AGR_Y_AXIS | LSM303AGR_X_AXIS));
	if (err) {
		DBG_PRINTK("%s: Can't enable accelerometer %d\n", __func__, err);
		return PKT_MNGR_ACCEL_DEVICE_FAILURE;
	}

	/* Set accelerometer scale */
	if (lsm303agr_accel_set_scale(LSM303AGR_8G)) {
		printk("Couldn't set accelerometer scale\n");
	}

	return PKT_MNGR_SUCCESS;
}

static int configure_rn2483(void)
{
	int err;

	/* Initialize the UART */
	err = rn2483_lora_init(CONFIG_UART_SAM0_SERCOM2_LABEL);
	if (err) {
		DBG_PRINTK("%s: Can't init RN2483 %d\n", __func__, err);
		return PKT_MNGR_LORA_DEVICE_FAILURE;
	}

	/* Pause mac layer */
	err = rn2483_lora_pause_mac();
	if (err) {
		DBG_PRINTK("%s: Can't pause mac layer %d\n", __func__, err);
		return PKT_MNGR_LORA_DEVICE_FAILURE;
	}

	/* Set spreading factor */
	err = rn2483_lora_radio_set_sf(LORA_SPREADING_FACTOR);
	if (err) {
		DBG_PRINTK("%s: Can't set spreading factor %d\n", __func__, err);
		return PKT_MNGR_LORA_DEVICE_FAILURE;
	}

	/* Set power output */
	err = rn2483_lora_radio_set_pwr(LORA_POWER_OUTPUT);
	if (err) {
		DBG_PRINTK("%s: Can't set power output %d\n", __func__, err);
		return PKT_MNGR_LORA_DEVICE_FAILURE;
	}

	return PKT_MNGR_SUCCESS;
}

static int configure_gps(void)
{
	int err;

	/* Initialize the gps */
	err = ubloxeva8m_init(CONFIG_I2C_SAM0_SERCOM3_LABEL);
	if (err) {
		DBG_PRINTK("%s: Can't initialize UBloxEVA8M %d\n", __func__, err);
		return PKT_MNGR_GPS_DEVICE_FAILURE;
	}

	/* Set callback function */
	ubloxeva8m_set_callback(gps_msg_callback);

	/* Start module */
	err = ubloxeva8m_start();
	if (err) {
		DBG_PRINTK("%s: Can't start GPS module %d\n", __func__, err);
		return PKT_MNGR_GPS_DEVICE_FAILURE;
	}

	/* Set the dynamic model used by the GPS */
	err = ubloxeva8m_set_dynamic_model(UBLOXEVA8M_DYNMODEL_AUTOMOTIVE);
	if (err) {
		DBG_PRINTK("%s: Can't set dynamic model %d\n", __func__, err);
		return PKT_MNGR_GPS_DEVICE_FAILURE;
	}

	return PKT_MNGR_SUCCESS;
}

int pkt_mngr_init(void)
{
	int err;

	if (pkt_mngr.initialized) {
		return PKT_MNGR_SUCCESS;
	}

	DBG_PRINTK("%s: Initializing RN2483\n", __func__);
	/* Configure the LoRa chip */
	err = configure_rn2483();
	if (err) {
		return err;
	}

	DBG_PRINTK("%s: Initializing UBloxEVA8M\n", __func__);
	/* Configure the GPS */
	err = configure_gps();
	if (err) {
		return err;
	}

	DBG_PRINTK("%s: Initializing LSM303AGR\n", __func__);
	/* Configure the accelerometer */
	err = configure_lsm303agr();
	if (err) {
		return err;
	}

	pkt_mngr.initialized = true;

	return PKT_MNGR_SUCCESS;
}

int pkt_mngr_start(void)
{
	if (!pkt_mngr.initialized) {
		return PKT_MNGR_NOT_INITIALIZED;
	}

	k_thread_start(packet_mngr_thread_id);

	return PKT_MNGR_SUCCESS;
}

void pkt_mngr_set_heart_rate(u8_t heart_rate) {
	pkt_mngr.heart_rate = heart_rate;
}

void pkt_mngr_set_cadence(u8_t cadence) {
	pkt_mngr.cadence = cadence;
}

/* Thread definition for the RN2483 LoRa module */
K_THREAD_DEFINE(packet_mngr_thread_id, PKT_MANAGER_STACK_SIZE, pkt_mngr_thread, NULL, NULL, NULL, PKT_MANAGER_PRIORITY, 0, K_FOREVER);
```

## src/packet_manager.h
```c
/** 
 * @file packet_manager.h
 * @brief Packet Manager module
 *
 * The Packet Manager module is responsible for periodically
 * creating and sending the Race Tracking Packet containing
 * the information about the competitor
 *
 * @author Léonard Bise
 * @date   Jul 23, 2018
 */
#ifndef SRC_PACKET_MANAGER_H_
#define SRC_PACKET_MANAGER_H_

#include <zephyr.h>

/**
 * Statuses of the packet manager
 */
#define PKT_MNGR_SUCCESS 0
#define PKT_MNGR_NOT_INITIALIZED -1
#define PKT_MNGR_LORA_DEVICE_FAILURE -2
#define PKT_MNGR_GPS_DEVICE_FAILURE -3
#define PKT_MNGR_ACCEL_DEVICE_FAILURE -4

/**
 * Initialze the packet manager
 * @return One of packet manager statuses
 */
int pkt_mngr_init(void);

/**
 * Starts the packet manager
 */
int pkt_mngr_start(void);

/**
 * Sets the heart rate sent in the packets
 * @param heart_rate Heart Rate
 */
void pkt_mngr_set_heart_rate(u8_t heart_rate);

/**
 * Sets the cadence sent in the packets
 * @param cadence Cadence
 */
void pkt_mngr_set_cadence(u8_t cadence);

#endif /* SRC_PACKET_MANAGER_H_ */
```

## src/race_sensor_manager.c
```c
/** 
 * @file packet_manager.c
 * @brief Packet Manager module
 *
 * The Packet Manager module is responsible for periodically
 * creating and sending the Race Tracking Packet containing
 * the information about the competitor
 *
 * @author Léonard Bise
 * @date   Jul 23, 2018
 */

#include "race_sensor_manager.h"

#include "debug.h"

#include "sensor_config.h"
#include "RN2483_lora.h"
#include "UBloxEVA8M.h"
#include "LSM303AGR.h"
#include "race_tracking_packet.h"
#include "leds.h"
#include "heart_rate.h"
#include "cadence.h"

#include <string.h>
#include <misc/byteorder.h>

/**
 * Set debug
 */
#define DEBUG DEBUG_RACE_SENSOR_MNGR

/**
 * Marker used to signal the beginning of the packet
 */
#define RACE_SENSOR_MNGR_SYNC_MARKER 0xF0CACC1A

/**
 * Stack size allocated for the packet manager thread
 */
#define RACE_SENSOR_MNGR_STACK_SIZE 1024

/**
 * Thread priority for the packet manager thread
 */
#define RACE_SENSOR_MNGR_PRIORITY 10

/**
 * The interval between two thread execution
 */
#define RACE_SENSOR_MNGR_THREAD_INTERVAL K_MSEC(15000)

static int msg_interval = RACE_SENSOR_MNGR_THREAD_INTERVAL;

/**
 * The minimum number of satellites we are waiting for during GPS fix
 */
#define RACE_SENSOR_MNGR_GPS_FIX_NB_SV 4

/**
 * The fix type we are waiting for during GPS fix
 */
#define RACE_SENSOR_MNGR_GPS_FIX_TYPE (UBLOXEVA8M_NAV_PVT_FIXTYPE_2D_FIX_MASK \
				| UBLOXEVA8M_NAV_PVT_FIXTYPE_3D_FIX_MASK)

/* The thread id for LoRa */
extern const k_tid_t race_sensor_mngr_thread_id;

/* Semaphore used to wait for GPS updates */
K_SEM_DEFINE(race_sensor_mngr_gps_sem, 0, 1);

struct race_sensor_mngr_data {
	bool initialized;
	k_tid_t thread_id;
	struct k_thread *thread_data;
	struct k_sem *gps_sem;
	ubloxeva8m_nav_pvt_t last_pvt_msg;
	u16_t pkt_seq;
};

struct race_sensor_mngr_data race_sensor_mngr = {
	.initialized = false,
	.gps_sem = &race_sensor_mngr_gps_sem,
	.pkt_seq = 0,
};

/**
 * Buffer used to hold a packet
 */
struct race_tracking_pkt  pkt_buffer;

#ifdef DEBUG
static void print_nav_pvt_msg(char *txt, ubloxeva8m_nav_pvt_t* msg)
{
	DBG_PRINTK("UBX-NAV-PVT: %d.%d.%d %02d:%02d:%02d:%03d validity=%d fixType=%d numSV=%d lat=%d lon=%d \n", msg->day, msg->month, msg->year, msg->hour, msg->minute, msg->seconds, msg->nano, msg->valid, msg->fixType, msg->numSV, msg->lat, msg->lon);
}
#endif

static void gps_msg_callback(ubloxeva8m_ubx_msg* msg)
{
	if (msg->class_id == UBLOXEVA8M_CLASS_NAV && msg->message_id == UBLOXEVA8M_MSG_NAV_PVT) {
		memcpy(&race_sensor_mngr.last_pvt_msg, msg->payload, sizeof(ubloxeva8m_nav_pvt_t));
		print_nav_pvt_msg("UBX-NAV-PVT: ", &race_sensor_mngr.last_pvt_msg);
		k_sem_give(race_sensor_mngr.gps_sem);
	}
}

static void wait_for_gps_update(void)
{
	/* Wait for new GPS message */
	k_sem_reset(race_sensor_mngr.gps_sem);
	k_sem_take(race_sensor_mngr.gps_sem, K_FOREVER);
}

#if RACE_SENSOR_DO_GPS_FIX > 0
static void wait_for_fix()
{
	bool led_state = false;

	DBG_PRINTK("%s: Waiting for GPS fix...\n", __func__);

	do {
		wait_for_gps_update();
		leds_set(LED_GREEN, led_state);
		led_state = led_state ? false : true;
	} while(race_sensor_mngr.last_pvt_msg.numSV < RACE_SENSOR_MNGR_GPS_FIX_NB_SV ||
			(race_sensor_mngr.last_pvt_msg.fixType & RACE_SENSOR_MNGR_GPS_FIX_TYPE));

	DBG_PRINTK("%s: Found GPS fix Num SV=%d FixType=0x%x\n", __func__, race_sensor_mngr.last_pvt_msg.numSV, race_sensor_mngr.last_pvt_msg.fixType);
}
#endif

static int build_packet(struct race_tracking_pkt *packet)
{
	/* In order to have the most precise GPS position we
	 * wait for a new one */
	/* TODO Synch on gps message cycle? */
	wait_for_gps_update();

	/* Data is transfered as big endian */
	packet->marker = sys_cpu_to_be32(RACE_SENSOR_MNGR_SYNC_MARKER);

	packet->id = sys_cpu_to_be16(SENSOR_ID);

	packet->reserved = 0;
	packet->year = sys_cpu_to_be16(race_sensor_mngr.last_pvt_msg.year);
	packet->mon = race_sensor_mngr.last_pvt_msg.month;
	packet->day = race_sensor_mngr.last_pvt_msg.day;
	packet->h = race_sensor_mngr.last_pvt_msg.hour;
	packet->min = race_sensor_mngr.last_pvt_msg.minute;
	packet->sec = race_sensor_mngr.last_pvt_msg.seconds;

	packet->status = 0;

	packet->counter = sys_cpu_to_be16(race_sensor_mngr.pkt_seq);
	race_sensor_mngr.pkt_seq++;

	packet->latitude = sys_cpu_to_be32(race_sensor_mngr.last_pvt_msg.lat);

	packet->longitude = sys_cpu_to_be32(race_sensor_mngr.last_pvt_msg.lon);

	packet->nb_sv = race_sensor_mngr.last_pvt_msg.numSV;

	packet->pdop = sys_cpu_to_be16(race_sensor_mngr.last_pvt_msg.pDOP);

	packet->heart_rate = hr_get();

	packet->cadence = cadence_get();

	return RACE_SENSOR_MNGR_SUCCESS;
}

static void race_sensor_mngr_thread(void)
{
	DBG_PRINTK("%s: Enter thread\n", __func__);

	/* Before sending packets we are going to wait to have a good GPS fix
	 * in order to provide precise positions */
#if RACE_SENSOR_DO_GPS_FIX > 0
	wait_for_fix();
#else
	DBG_PRINTK("%s: Not waiting for GPS Fix!\n", __func__);
#endif

	/* Switch-on green LED to signify sensor has a GPS fix */
	leds_set(LED_GREEN, true);

	while (1) {
		k_sleep(msg_interval);
		/* Build packet */
		if (build_packet(&pkt_buffer) < 0) {
			DBG_PRINTK("Couldn't build packet\n");
		}

		/* Send through LoRa */
		if (rn2483_lora_radio_tx((u8_t*)&pkt_buffer, sizeof(struct race_tracking_pkt))) {
			DBG_PRINTK("Couldn't send packet\n");
		}
	}
}

static int configure_lsm303agr(void)
{
	int err;

	/* Initialize the LSM303AGR module */
	err = lsm303agr_init(CONFIG_I2C_SAM0_SERCOM3_LABEL);
	if (err) {
		DBG_PRINTK("%s: Can't init LSM303AGR %d\n", __func__, err);
		return RACE_SENSOR_MNGR_ACCEL_DEVICE_FAILURE;
	}

	/* Enable the accelerometer */
	err = lsm303agr_accel_enable(LSM303AGR_NORMAL_MODE, LSM303AGR_HIGH_RES_100HZ, false, (LSM303AGR_Z_AXIS | LSM303AGR_Y_AXIS | LSM303AGR_X_AXIS));
	if (err) {
		DBG_PRINTK("%s: Can't enable accelerometer %d\n", __func__, err);
		return RACE_SENSOR_MNGR_ACCEL_DEVICE_FAILURE;
	}

	/* Set accelerometer scale */
	if (lsm303agr_accel_set_scale(LSM303AGR_8G)) {
		printk("Couldn't set accelerometer scale\n");
	}

	return RACE_SENSOR_MNGR_SUCCESS;
}

static int configure_rn2483(void)
{
	int err;

	/* Initialize the UART */
	err = rn2483_lora_init(CONFIG_UART_SAM0_SERCOM2_LABEL);
	if (err) {
		DBG_PRINTK("%s: Can't init RN2483 %d\n", __func__, err);
		return RACE_SENSOR_MNGR_LORA_DEVICE_FAILURE;
	}

	/* Pause mac layer */
	err = rn2483_lora_pause_mac();
	if (err) {
		DBG_PRINTK("%s: Can't pause mac layer %d\n", __func__, err);
		return RACE_SENSOR_MNGR_LORA_DEVICE_FAILURE;
	}

	/* Set spreading factor */
	err = rn2483_lora_radio_set_sf(LORA_SPREADING_FACTOR);
	if (err) {
		DBG_PRINTK("%s: Can't set spreading factor %d\n", __func__, err);
		return RACE_SENSOR_MNGR_LORA_DEVICE_FAILURE;
	}

	/* Set power output */
	err = rn2483_lora_radio_set_pwr(LORA_POWER_OUTPUT);
	if (err) {
		DBG_PRINTK("%s: Can't set power output %d\n", __func__, err);
		return RACE_SENSOR_MNGR_LORA_DEVICE_FAILURE;
	}

	return RACE_SENSOR_MNGR_SUCCESS;
}

static int configure_gps(void)
{
	int err;

	/* Initialize the gps */
	err = ubloxeva8m_init(CONFIG_I2C_SAM0_SERCOM3_LABEL);
	if (err) {
		DBG_PRINTK("%s: Can't initialize UBloxEVA8M %d\n", __func__, err);
		return RACE_SENSOR_MNGR_GPS_DEVICE_FAILURE;
	}

	/* Set callback function */
	ubloxeva8m_set_callback(gps_msg_callback);

	/* Start module */
	err = ubloxeva8m_start();
	if (err) {
		DBG_PRINTK("%s: Can't start GPS module %d\n", __func__, err);
		return RACE_SENSOR_MNGR_GPS_DEVICE_FAILURE;
	}

	/* Set the dynamic model used by the GPS */
	err = ubloxeva8m_set_dynamic_model(UBLOXEVA8M_DYNMODEL_AUTOMOTIVE);
	if (err) {
		DBG_PRINTK("%s: Can't set dynamic model %d\n", __func__, err);
		return RACE_SENSOR_MNGR_GPS_DEVICE_FAILURE;
	}

	return RACE_SENSOR_MNGR_SUCCESS;
}

int race_sensor_mngr_init(void)
{
	int err;

	if (race_sensor_mngr.initialized) {
		return RACE_SENSOR_MNGR_SUCCESS;
	}

	DBG_PRINTK("%s: Initializing RN2483\n", __func__);
	/* Configure the LoRa chip */
	err = configure_rn2483();
	if (err) {
		return err;
	}

	DBG_PRINTK("%s: Initializing UBloxEVA8M\n", __func__);
	/* Configure the GPS */
	err = configure_gps();
	if (err) {
		return err;
	}

	DBG_PRINTK("%s: Initializing LSM303AGR\n", __func__);
	/* Configure the accelerometer */
	err = configure_lsm303agr();
	if (err) {
		return err;
	}

	DBG_PRINTK("%s: Initializing Heart_Rate\n", __func__);
	err = hr_init(GPIO_HR_DEV, GPIO_HR_PIN);
	if (err < 0) {
		return err;
	}

	DBG_PRINTK("%s: Initializing Cadence\n", __func__);
	err = cadence_init(CONFIG_I2C_SAM0_SERCOM3_LABEL, ACCEL_INT_DEV, ACCEL_INT1_PIN);
	if (err < 0) {
		return err;
	}

	race_sensor_mngr.initialized = true;

	return RACE_SENSOR_MNGR_SUCCESS;
}

int race_sensor_mngr_start(void)
{
	if (!race_sensor_mngr.initialized) {
		return RACE_SENSOR_MNGR_NOT_INITIALIZED;
	}

	k_thread_start(race_sensor_mngr_thread_id);

	return RACE_SENSOR_MNGR_SUCCESS;
}

void race_sensor_mngr_set_msg_interval(int interval)
{
	msg_interval = K_MSEC(interval);
}

/* Thread definition for the RN2483 LoRa module */
K_THREAD_DEFINE(race_sensor_mngr_thread_id, RACE_SENSOR_MNGR_STACK_SIZE, race_sensor_mngr_thread, NULL, NULL, NULL, RACE_SENSOR_MNGR_PRIORITY, 0, K_FOREVER);
```

## src/race_sensor_manager.h
```c
/** 
 * @file race_sensor_manager.h
 * @brief Race Sensor Manager module
 *
 * The Race Sensor Manager module is responsible for periodically
 * performing the required acquisitions, creating and sending the
 * Race Tracking Packet containing the information about the competitor
 *
 * @author Léonard Bise
 * @date   Jul 23, 2018
 */
#ifndef SRC_RACE_SENSOR_MANAGER_H_
#define SRC_RACE_SENSOR_MANAGER_H_

#include <zephyr.h>

/**
 * Statuses of the race sensor manager
 */
#define RACE_SENSOR_MNGR_SUCCESS 0
#define RACE_SENSOR_MNGR_NOT_INITIALIZED -1
#define RACE_SENSOR_MNGR_LORA_DEVICE_FAILURE -2
#define RACE_SENSOR_MNGR_GPS_DEVICE_FAILURE -3
#define RACE_SENSOR_MNGR_ACCEL_DEVICE_FAILURE -4

/**
 * Initialze the race sensor manager
 * @return One of race sensor manager statuses
 */
int race_sensor_mngr_init(void);

/**
 * Starts the race sensor manager
 */
int race_sensor_mngr_start(void);

/**
 * Sets the heart rate sent in the packets
 * @param heart_rate Heart Rate
 */
void race_sensor_mngr_set_heart_rate(u8_t heart_rate);

/**
 * Sets the cadence sent in the packets
 * @param cadence Cadence
 */
void race_sensor_mngr_set_cadence(u8_t cadence);

#endif /* SRC_RACE_SENSOR_MANAGER_H_ */
```

## src/race_sensor_shell.c
```c
/** 
 * @file race_sensor_shell.c
 * @brief Module description
 *
 * Detailed module description
 *
 * @author Léonard Bise
 * @date   Jul 29, 2018
 */

#include "race_sensor_shell.h"

#include <zephyr.h>
#include <stdlib.h>

#include "RN2483_lora.h"
#include "race_sensor_manager.h"

int race_sensor_shell_set_lora_sf(int argc, char *argv[]) {
	int err;

	if (argc != 2) {
		printk("Wrong number of arguments\n");
		return -EINVAL;
	}

	err = rn2483_lora_radio_set_sf(argv[1]);
	if (err < 0) {
		printk("Couldn't set spreading factor %s : %d\n", argv[1], err);
		return err;
	} else {
		printk("Set LoRa spreading factor %s successfully\n", argv[1]);
	}

	return 0;
}

int race_sensor_shell_set_lora_pwr(int argc, char *argv[]) {
	int err;
	s8_t pwr;
	char *end;

	if (argc != 2) {
		printk("Wrong number of arguments\n");
		return -EINVAL;
	}

	pwr = strtol(argv[1], &end, 0);

	err = rn2483_lora_radio_set_pwr(pwr);
	if (err < 0) {
		printk("Couldn't set power output %d : %d\n", pwr, err);
		return err;
	} else {
		printk("Set LoRa power output %d successfully\n", pwr);
	}

	return 0;
}

int race_sensor_shell_set_msg_interval(int argc, char *argv[]) {
	int interval;
	char *end;

	if (argc != 2) {
		printk("Wrong number of arguments\n");
		return -EINVAL;
	}

	interval = strtol(argv[1], &end, 0);
	race_sensor_mngr_set_msg_interval(interval);

	return 0;
}
```

## src/race_sensor_shell.h
```c
/** 
 * @file race_sensor_shell.h
 * @brief Module description
 *
 * Detailed module description
 *
 * @author Léonard Bise
 * @date   Jul 29, 2018
 */
#ifndef SRC_RACE_SENSOR_SHELL_H_
#define SRC_RACE_SENSOR_SHELL_H_

/**
 * Set the LoRa spreading factor
 * @param argc Number of arguments
 * @param argv Arguments array
 * @return 0 on success, negative errno code on failure
 */
int race_sensor_shell_set_lora_sf(int argc, char *argv[]);

/**
 * Set the LoRa power output
 * @param argc Number of arguments
 * @param argv Arguments array
 * @return 0 on success, negative errno code on failure
 */
int race_sensor_shell_set_lora_pwr(int argc, char *argv[]);

/**
 * Sets the interval between two messages
 * @param argc Number of arguments
 * @param argv Arguments array
 * @return 0 on success, negative errno code on failure
 */
int race_sensor_shell_set_msg_interval(int argc, char *argv[]);

#endif /* SRC_RACE_SENSOR_SHELL_H_ */
```

## src/race_tracking_packet.h
```c
/** 
 * @file race_tracking_packet.h
 * @brief The Race Tracking Packet definition
 *
 * This is the definition of the Race Tracking Packet which is sent
 * at regular interface and provides information on the competitor.
 *
 * @author Léonard Bise
 * @date   Jul 26, 2018
 */
#ifndef SRC_RACE_TRACKING_PACKET_H_
#define SRC_RACE_TRACKING_PACKET_H_

struct race_tracking_pkt {
	u32_t marker;
	u16_t id;
	u8_t reserved;
	u16_t year;
	u8_t mon;
	u8_t day;
	u8_t h;
	u8_t min;
	u8_t sec;
	u8_t status;
	u16_t counter;
	s32_t latitude;
	s32_t longitude;
	u8_t nb_sv;
	u16_t pdop;
	u8_t heart_rate;
	u8_t cadence;
} __attribute__((packed,aligned(1)));

#endif /* SRC_RACE_TRACKING_PACKET_H_ */
```
