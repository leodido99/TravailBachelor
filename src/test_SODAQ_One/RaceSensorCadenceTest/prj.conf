## prj.conf
```kconfig
CONFIG_SYS_LOG=y
CONFIG_SYS_LOG_DEFAULT_LEVEL=3
CONFIG_SYS_LOG_I2C_LEVEL=3
CONFIG_SYS_LOG_GPIO_SAM0_LEVEL=4
CONFIG_SYS_LOG_EXTI_SAM0_LEVEL=4

CONFIG_OBJECT_TRACING=y
CONFIG_THREAD_MONITOR=y
CONFIG_MPU_STACK_GUARD=y

CONFIG_CONSOLE_SHELL=y

#CONFIG_ASSERT=y
```

## src/main.c
```c
/** 
 * @file main.c
 * @brief Entry point
 *
 * Entry point for the RaceSensor application
 *
 * @author Léonard Bise
 * @date   Jul 23, 2018
 */

#include <kernel.h>
#include <shell/shell.h>

#include "debug.h"
/**
 * Set debug
 */
#define DEBUG DEBUG_MAIN

#include "race_sensor_manager.h"
#include "RN2483_lora.h"
#include "UBloxEVA8M.h"
#include "leds.h"
#include "race_sensor_shell.h"

/**
 * Delay used to make the LED blink on fatal error
 */
#define FATAL_ERR_LED_DELAY 100

#define RACE_SENSOR_SHELL "race-sensor"

/**
 * Function called in case of a fatal error
 */
static void fatal_error(char *msg)
{
	DBG_PRINTK("FATAL ERROR! %s\n", msg);

	while(1) {
		leds_set(LED_RED, true);
		k_sleep(FATAL_ERR_LED_DELAY);
		leds_set(LED_RED, false);
		k_sleep(FATAL_ERR_LED_DELAY);
	}
}

static struct shell_cmd commands[] = {
	{ "set_lora_sf", race_sensor_shell_set_lora_sf, "<sf>\n\nSets the LoRa spreading factor (sf7 to sf12)"},
	{ "set_lora_pwr", race_sensor_shell_set_lora_pwr, "<pwr>\n\nSets the LoRa power output (-3 to 15)"},
	{ "set_msg_interval", race_sensor_shell_set_msg_interval , "<ms>\n\nSets the sensor message interval" },
	{ "cadence_samples" , race_sensor_shell_cadence_samples, ""},
	{ "cadence_reset" , race_sensor_shell_cadence_reset, ""},
	{ "cadence_scale", race_sensor_shell_cadence_scale, " <value>" },
	{ NULL, NULL, NULL }
};

void main(void)
{
	int err;

#if defined(CONFIG_OBJECT_TRACING) && defined(CONFIG_THREAD_MONITOR)
	dbg_print_threads();
#endif

	err = leds_init();
	if (err < 0) {
		fatal_error("Cannot init LEDs");
	}

	DBG_PRINTK("%s: Initializing race sensor manager\n", __func__);
	err = race_sensor_mngr_init();
	if (err < 0) {
		fatal_error("Cannot init race sensor manager");
	}

	DBG_PRINTK("%s: Starting race sensor manager\n", __func__);
	err = race_sensor_mngr_start();
	if (err < 0) {
		fatal_error("Cannot start race sensor manager");
	}

	DBG_PRINTK("%s: Starting\n", __func__);

	/* Setup race sensor shell */
	SHELL_REGISTER(RACE_SENSOR_SHELL, commands);
	shell_register_default_module(RACE_SENSOR_SHELL);

}
```

## src/cadence.c
```c
/*
 * cadence.c
 *
 *  Created on: 17 Aug 2018
 *      Author: leonard.bise
 */

#include "cadence.h"

#include <gpio.h>
#include <pinmux.h>
#include <stdio.h>

#include "LSM303AGR.h"
#include "leds.h"
#include "sensor_config.h"

#include "debug.h"

#define DEBUG 1
#define CADENCE_TEST 1
//#define CADENCE_USE_SAMPLING 1

struct cadence {
	struct gpio_callback int1_cb;
	int step_cnt;
	s64_t start_time;
};

struct cadence cadence_priv;

extern const k_tid_t cadence_thread_id;

#ifdef CADENCE_USE_SAMPLING

extern const k_tid_t cadence_sampling_thread_id;

/* See LSM303AGR 18000 / 64 * 4 / 1000 = 1.125g */
#define CADENCE_THRESHOLD 18000

/**
 * Stack size allocated for the cadence sampling thread
 */
#define CADENCE_STACK_SIZE 1024

/**
 * Thread priority for the cadence sampling thread
 */
#define CADENCE_PRIORITY 5000

/* 1 second of samples */
#define CADENCE_NB_SAMPLE 20
/* Interval between two samples */
#define CADENCE_SAMPLING_INTERVAL K_MSEC(50)

struct cadence_sample_t {
	int16_t sample;
};

struct cadence_sampling_t {
	uint16_t nb_samples;
	uint8_t nb_occurances;
	bool counted;
	struct cadence_sample_t samples[CADENCE_NB_SAMPLE];
	struct cadence_sample_t previous_sample;
};

struct cadence_sampling_t cadence_sampling = {
	.nb_samples = 0,
	.nb_occurances = 0,
	.counted = false
};

#endif

static void new_step(void)
{
	if (cadence_priv.start_time == 0) {
		cadence_priv.start_time = k_uptime_get();
	}

	printk("step!\n");
	cadence_priv.step_cnt++;
}

/**
 * Stack size allocated for the packet manager thread
 */
#define CADENCE_STACK_SIZE 1024

/**
 * Thread priority for the packet manager thread
 */
#define CADENCE_PRIORITY 0

#define CADENCE_INTERVAL K_MSEC(50)

#define CADENCE_NB_DATA_POINT 200 /* 10 seconds */

struct cadence_data {
	u8_t dev;
	/*double accel_x;
	double accel_y;
	double accel_z;*/
	u32_t ts;
	int16_t accel_x;
	int16_t accel_y;
	int16_t accel_z;
};

struct cadence_data_points {
	u32_t nb_data_point;
	struct cadence_data data[CADENCE_NB_DATA_POINT];
};

struct cadence_data_points data_points = {
	.nb_data_point = 0
};

void cadence_print(void)
{
	char buffer[256];

	printk("Printing %d Cadence points:\ndevice\ttime[ms]\tx scaled\ty scaled\tz scaled\tx\ty\tz\n", data_points.nb_data_point);

	for (int i = 0; i < data_points.nb_data_point; i++) {
		snprintf(buffer, 256, "%d\t%d\t%f\t%f\t%f\t%d\t%d\t%d\n", data_points.data[i].dev, data_points.data[i].ts,
				lsm303agr_get_scaled_value(data_points.data[i].accel_x),
				lsm303agr_get_scaled_value(data_points.data[i].accel_y),
				lsm303agr_get_scaled_value(data_points.data[i].accel_z),
				data_points.data[i].accel_x,
				data_points.data[i].accel_y,
				data_points.data[i].accel_z);
		printk("%s", buffer);
	}
}

void cadence_reset_samples(void)
{
	data_points.nb_data_point = 0;
}

static void cadence_thread(void)
{
	bool msg = true;
	bool led_state = false;

	while (1) {
		if (data_points.nb_data_point < CADENCE_NB_DATA_POINT) {
			data_points.data[data_points.nb_data_point].dev = lsm303agr_accel_get_device_id();

			if (lsm303agr_get_x_acceleration(&data_points.data[data_points.nb_data_point].accel_x) < 0) {
				DBG_PRINTK("Cannot get x accel\n");
			}

			if (lsm303agr_get_y_acceleration(&data_points.data[data_points.nb_data_point].accel_y) < 0) {
				DBG_PRINTK("Cannot get y accel\n");
			}

			if (lsm303agr_get_z_acceleration(&data_points.data[data_points.nb_data_point].accel_z) < 0) {
				DBG_PRINTK("Cannot get z accel\n");
			}

			data_points.data[data_points.nb_data_point].ts = k_uptime_get_32();

			data_points.nb_data_point++;

			leds_set(LED_RED, led_state);
			led_state = led_state ? false : true;
		} else if (msg) {
			DBG_PRINTK("Got all samples\n");
			msg = false;
			leds_set(LED_GREEN, led_state);
		}

		k_sleep(CADENCE_INTERVAL);
	}
}

static int get_steps(void)
{
	return cadence_priv.step_cnt;
}

#ifdef CADENCE_USE_SAMPLING
static int fetch_sample(int16_t *sample)
{
	int err;

	err = lsm303agr_get_z_acceleration(sample);
	if (err < 0) {
		return err;
	}

	return 0;
}

static bool is_overthreshold(struct cadence_sample_t sample)
{
	/* TODO Threshold negative? */
	return (sample.sample > CADENCE_THRESHOLD);
}

static int process_samples(struct cadence_sampling_t *sampling)
{
	int i;

	if (!sampling) {
		DBG_PRINTK("Bad parameters\n");
		return -EINVAL;
	}

	/* Detect step */
	for (i = 0; i < sampling->nb_samples; i++) {
		if (is_overthreshold(sampling->samples[i])) {
			/* Only count once the sample is over the threashold
			 * signal must come back under it to be counted again
			 */
			if (!sampling->counted) {
				new_step();
				sampling->counted = true;
			}
		} else {
			sampling->counted = false;
		}
	}

	return 0;
}

static void cadence_sampling_thread(void *arg1, void *arg2, void *arg3)
{
	struct cadence_sampling_t *sampling = arg1;
	int cnt = 0;

	while (1) {
		/* Get sample */
		if (fetch_sample(&sampling->samples[sampling->nb_samples].sample) < 0) {
			DBG_PRINTK("Cannot get sample\n");
			continue;
		}

		sampling->nb_samples++;

		if (sampling->nb_samples == CADENCE_NB_SAMPLE) {
			process_samples(sampling);
			cnt++;
			sampling->nb_samples = 0;
			if (cnt == 9) {
				DBG_PRINTK("nb steps: %d\n", get_steps());
				cnt = 0;
			}
		}

		k_sleep(CADENCE_SAMPLING_INTERVAL);
	}
}
#endif

void cadence_gpio_callback(struct device *port, struct gpio_callback *cb, u32_t pins)
{
	DBG_PRINTK("GPIO ISR");
	new_step();
}

static int configure_lsm303agr(const char* device)
{
	int err;

	/* Initialize the LSM303AGR module */
	err = lsm303agr_init(device);
	if (err) {
		DBG_PRINTK("%s: Can't init LSM303AGR %d\n", __func__, err);
		return CADENCE_CONFIGURATION_ERROR;
	}

	/* Enable the accelerometer */
	err = lsm303agr_accel_enable(LSM303AGR_NORMAL_MODE, LSM303AGR_HIGH_RES_100HZ, false, (LSM303AGR_Z_AXIS | LSM303AGR_Y_AXIS | LSM303AGR_X_AXIS));
	if (err) {
		DBG_PRINTK("%s: Can't enable accelerometer %d\n", __func__, err);
		return CADENCE_CONFIGURATION_ERROR;
	}

	/* Configure interruption */
	err = lsm303agr_configure_interrupt1(LSM303AGR_INT_AND_COMBINATION,
			LSM303AGR_INT_DIR_Z_HIGH);
	if (err < 0) {
		DBG_PRINTK("%s: Cannot configure interrupt 1", __func__);
		return CADENCE_CONFIGURATION_ERROR;
	}

	/* Set interrupt threshold */
	err = lsm303agr_set_interrupt_threshold(ACCELEROMETER_Z_THRESHOLD);
	if (err < 0) {
		DBG_PRINTK("%s: Cannot set threshold", __func__);
	}

	/* Set duration of the interrupt */
	err = lsm303agr_set_interrupt_duration(ACCELEROMETER_INT_DURATION);
	if (err < 0) {
		DBG_PRINTK("%s: Cannot set duration", __func__);
	}

	/* Enable interrupt */
	err = lsm303agr_enable_interrupt(LSM303AGR_INT_AOI1);
	if (err < 0) {
		DBG_PRINTK("%s: Cannot enable interrupt 1", __func__);
		return CADENCE_CONFIGURATION_ERROR;
	}

	return 0;
}

static int setup_gpio_irq(const char* device, int pin)
{
	struct device *dev;
	int err;

	/* Update pin function to EXTINT */
	dev = device_get_binding(CONFIG_PINMUX_SAM0_A_LABEL);
	if (!dev) {
		DBG_PRINTK("%s: Binding to pinmux failed\n", __func__);
		return CADENCE_BINDING_FAILED;
	}

	/* INT2 */
	err = pinmux_pin_set(dev, 20, PINMUX_FUNC_A);
	if (err < 0) {
		DBG_PRINTK("%s: Cannot change pin function\n", __func__);
		return err;
	}

	/* INT1 */
	err = pinmux_pin_set(dev, 21, PINMUX_FUNC_A);
	if (err < 0) {
		DBG_PRINTK("%s: Cannot change pin function\n", __func__);
		return err;
	}

	dev = device_get_binding(device);
	if (!dev) {
		DBG_PRINTK("%s: Binding to gpio failed\n", __func__);
		return CADENCE_BINDING_FAILED;
	}

	gpio_init_callback(&cadence_priv.int1_cb, cadence_gpio_callback, BIT(pin));

	err = gpio_add_callback(dev, &cadence_priv.int1_cb);
	if (err < 0) {
		DBG_PRINTK("%s: Cannot add callback\n", __func__);
		return err;
	}

	/* Interruption on rising edge */
	err = gpio_pin_configure(dev, pin, (GPIO_DIR_IN | GPIO_INT |
			 	 GPIO_INT_EDGE | GPIO_INT_ACTIVE_HIGH));
	if (err < 0) {
		DBG_PRINTK("%s: Cannot configure gpio pin %d", __func__, pin);
		return err;
	}

	err = gpio_pin_enable_callback(dev, pin);
	if (err < 0) {
		DBG_PRINTK("%s: Cannot add callback\n", __func__);
		return err;
	}

	return 0;
}

int cadence_init(const char* device, const char *irq_device, int irq_pin) {
	int err;

	err = configure_lsm303agr(device);
	if (err < 0) {
		return err;
	}

	err = setup_gpio_irq(irq_device, irq_pin);
	if (err < 0) {
		return err;
	}

#ifdef CADENCE_USE_SAMPLING
	k_thread_start(cadence_sampling_thread_id);
#endif

#ifdef CADENCE_TEST
	k_thread_start(cadence_thread_id);
#endif

	return 0;
}

u8_t cadence_get(void)
{
	u8_t spm;
	s64_t elapsed_s = (k_uptime_get() - cadence_priv.start_time) / 1000;

	spm = (60 * cadence_priv.step_cnt) / elapsed_s;

	DBG_PRINTK("%s: PPM=%d steps=%d elapsed=%lld s\n", __func__, spm, cadence_priv.step_cnt, elapsed_s);

	cadence_priv.step_cnt = 0;
	cadence_priv.start_time = 0;

	return spm;
}

#ifdef CADENCE_USE_SAMPLING
K_THREAD_DEFINE(cadence_sampling_thread_id, CADENCE_STACK_SIZE, cadence_sampling_thread, &cadence_sampling, NULL, NULL, CADENCE_PRIORITY, 0, K_FOREVER);
#endif

#ifdef CADENCE_TEST
K_THREAD_DEFINE(cadence_thread_id, CADENCE_STACK_SIZE, cadence_thread, NULL, NULL, NULL, CADENCE_PRIORITY, 0, K_FOREVER);
#endif
```

## src/cadence.h
```c
/*
 * cadence.h
 *
 *  Created on: 17 Aug 2018
 *      Author: leonard.bise
 */

#ifndef SRC_CADENCE_H_
#define SRC_CADENCE_H_

#include <zephyr.h>

#define CADENCE_SUCCESS 0
#define CADENCE_BINDING_FAILED -1
#define CADENCE_CONFIGURATION_ERROR -2

/**
 * Initialize the cadence module
 * @param device Device on which the LSM303AGR is connected
 * @param irq_device Device on which the IRQ is connected (GPIO port)
 * @param irq_pin Pin of the GPIO port on which IRQ is
 * @return 0 if success, negative errorno otherwise
 */
int cadence_init(const char* device, const char *irq_device, int irq_pin);

/**
 * Return the cadence in step per min
 * @return Cadence
 */
u8_t cadence_get(void);

void cadence_print(void);

void cadence_reset_samples(void);

#endif /* SRC_CADENCE_H_ */
```

## src/debug.c
```c
/** 
 * @file debug.c
 * @brief Debug module
 *
 * Provides debug functions
 *
 * @author Léonard Bise
 * @date   Jul 26, 2018
 */

#include "debug.h"

#include <zephyr.h>

static int dbg_thread_cnt = 0;

#if defined(CONFIG_OBJECT_TRACING) && defined(CONFIG_THREAD_MONITOR)
static void print_thread(const struct k_thread *thread, void *user_data) {
	printk("%d - %p : priority=%d", dbg_thread_cnt, thread, thread->base.prio);
	if (thread == k_current_get()) {
		printk(" <- Current Thread");
	}
	printk("\n");
	dbg_thread_cnt++;
}

void dbg_print_threads(void)
{
	printk("---------------------------------\n");
	printk("Threads:\n");
	printk("---------------------------------\n");
	dbg_thread_cnt = 0;
	k_thread_foreach(print_thread, NULL);
	printk("---------------------------------\n");
}
#endif
```

## src/heart_rate.h
```c
/**
 * @file heart_rate.h
 * @brief Heart Rate module
 *
 * Handles the IO associated with the Heart Rate module
 *
 * @author Léonard Bise
 * @date   Jul 23, 2018
 */

#ifndef SRC_HEART_RATE_H_
#define SRC_HEART_RATE_H_

#include <zephyr.h>

#define HR_SUCCESS 0
#define HR_BINDING_FAILED -1
#define HR_GPIO_ACCESSS_FAILED -2

/**
 * Initialize the heart rate module
 * Configures the GPIO and add an interruption that is
 * triggered on rising edges
 *
 * @param device GPIO device
 * @param pin GPIO pin
 * @return 0 if successful, error code otherwise
 */
int hr_init(const char* device, int pin);

/**
 * Returns the heart rate in beats per minutes
 *
 * @return Heart rate
 */
u8_t hr_get(void);

#endif /* SRC_HEART_RATE_H_ */
```

## src/race_sensor_manager.c
```c
/** 
 * @file packet_manager.c
 * @brief Packet Manager module
 *
 * The Packet Manager module is responsible for periodically
 * creating and sending the Race Tracking Packet containing
 * the information about the competitor
 *
 * @author Léonard Bise
 * @date   Jul 23, 2018
 */

#include "race_sensor_manager.h"

#include "debug.h"

#include "sensor_config.h"
#include "RN2483_lora.h"
#include "UBloxEVA8M.h"
#include "LSM303AGR.h"
#include "race_tracking_packet.h"
#include "leds.h"
#include "heart_rate.h"
#include "cadence.h"

#include <pinmux.h>
#include <string.h>
#include <misc/byteorder.h>

/**
 * Set debug
 */
#define DEBUG DEBUG_RACE_SENSOR_MNGR

/**
 * If the module must wait for a valid GPS fix before
 * starting to send packets. Used for debug
 */
#define RACE_SENSOR_DO_GPS_FIX 1

/**
 * Marker used to signal the beginning of the packet
 */
#define RACE_SENSOR_MNGR_SYNC_MARKER 0xF0CACC1A

/**
 * Stack size allocated for the packet manager thread
 */
#define RACE_SENSOR_MNGR_STACK_SIZE 1024

/**
 * Thread priority for the packet manager thread
 */
#define RACE_SENSOR_MNGR_PRIORITY 10

/**
 * The interval between two thread execution
 */
#define RACE_SENSOR_MNGR_THREAD_INTERVAL K_MSEC(15000)

static int msg_interval = RACE_SENSOR_MNGR_THREAD_INTERVAL;

/**
 * The minimum number of satellites we are waiting for during GPS fix
 */
#define RACE_SENSOR_MNGR_GPS_FIX_NB_SV 4

/**
 * The fix type we are waiting for during GPS fix
 */
#define RACE_SENSOR_MNGR_GPS_FIX_TYPE (UBLOXEVA8M_NAV_PVT_FIXTYPE_2D_FIX_MASK \
				| UBLOXEVA8M_NAV_PVT_FIXTYPE_3D_FIX_MASK)

/* The thread id for LoRa */
extern const k_tid_t race_sensor_mngr_thread_id;

/* Semaphore used to wait for GPS updates */
K_SEM_DEFINE(race_sensor_mngr_gps_sem, 0, 1);

struct race_sensor_mngr_data {
	bool initialized;
	k_tid_t thread_id;
	struct k_thread *thread_data;
	struct k_sem *gps_sem;
	ubloxeva8m_nav_pvt_t last_pvt_msg;
	u16_t pkt_seq;
};

struct race_sensor_mngr_data race_sensor_mngr = {
	.initialized = false,
	.gps_sem = &race_sensor_mngr_gps_sem,
	.pkt_seq = 0,
};

/**
 * Buffer used to hold a packet
 */
struct race_tracking_pkt  pkt_buffer;

#ifdef DEBUG
static void print_nav_pvt_msg(char *txt, ubloxeva8m_nav_pvt_t* msg)
{
	DBG_PRINTK("UBX-NAV-PVT: %d.%d.%d %02d:%02d:%02d:%03d validity=%d fixType=%d numSV=%d lat=%d lon=%d \n", msg->day, msg->month, msg->year, msg->hour, msg->minute, msg->seconds, msg->nano, msg->valid, msg->fixType, msg->numSV, msg->lat, msg->lon);
}
#endif

static void gps_msg_callback(ubloxeva8m_ubx_msg* msg)
{
	if (msg->class_id == UBLOXEVA8M_CLASS_NAV && msg->message_id == UBLOXEVA8M_MSG_NAV_PVT) {
		memcpy(&race_sensor_mngr.last_pvt_msg, msg->payload, sizeof(ubloxeva8m_nav_pvt_t));
		print_nav_pvt_msg("UBX-NAV-PVT: ", &race_sensor_mngr.last_pvt_msg);
		k_sem_give(race_sensor_mngr.gps_sem);
	}
}

static void wait_for_gps_update(void)
{
	/* Wait for new GPS message */
	k_sem_reset(race_sensor_mngr.gps_sem);
	k_sem_take(race_sensor_mngr.gps_sem, K_FOREVER);
}

#if RACE_SENSOR_DO_GPS_FIX > 0
static void wait_for_fix()
{
	bool led_state = false;

	DBG_PRINTK("%s: Waiting for GPS fix...\n", __func__);

	do {
		wait_for_gps_update();
		leds_set(LED_GREEN, led_state);
		led_state = led_state ? false : true;
	} while(race_sensor_mngr.last_pvt_msg.numSV < RACE_SENSOR_MNGR_GPS_FIX_NB_SV ||
			(race_sensor_mngr.last_pvt_msg.fixType & RACE_SENSOR_MNGR_GPS_FIX_TYPE));

	DBG_PRINTK("%s: Found GPS fix Num SV=%d FixType=0x%x\n", __func__, race_sensor_mngr.last_pvt_msg.numSV, race_sensor_mngr.last_pvt_msg.fixType);
}
#endif

static int build_packet(struct race_tracking_pkt *packet)
{
	/* In order to have the most precise GPS position we
	 * wait for a new one */
	/* TODO Synch on gps message cycle? */
	wait_for_gps_update();

	/* Data is transfered as big endian */
	packet->marker = sys_cpu_to_be32(RACE_SENSOR_MNGR_SYNC_MARKER);

	packet->id = sys_cpu_to_be16(SENSOR_ID);

	packet->reserved = 0;
	packet->year = sys_cpu_to_be16(race_sensor_mngr.last_pvt_msg.year);
	packet->mon = race_sensor_mngr.last_pvt_msg.month;
	packet->day = race_sensor_mngr.last_pvt_msg.day;
	packet->h = race_sensor_mngr.last_pvt_msg.hour;
	packet->min = race_sensor_mngr.last_pvt_msg.minute;
	packet->sec = race_sensor_mngr.last_pvt_msg.seconds;

	packet->status = 0;

	packet->counter = sys_cpu_to_be16(race_sensor_mngr.pkt_seq);
	race_sensor_mngr.pkt_seq++;

	packet->latitude = sys_cpu_to_be32(race_sensor_mngr.last_pvt_msg.lat);

	packet->longitude = sys_cpu_to_be32(race_sensor_mngr.last_pvt_msg.lon);

	packet->nb_sv = race_sensor_mngr.last_pvt_msg.numSV;

	packet->pdop = sys_cpu_to_be16(race_sensor_mngr.last_pvt_msg.pDOP);

	packet->heart_rate = hr_get();

	packet->cadence = cadence_get();

	return RACE_SENSOR_MNGR_SUCCESS;
}

static void race_sensor_mngr_thread(void)
{
	DBG_PRINTK("%s: Enter thread\n", __func__);

	/* Before sending packets we are going to wait to have a good GPS fix
	 * in order to provide precise positions */
#if RACE_SENSOR_DO_GPS_FIX > 0
	wait_for_fix();
#else
	DBG_PRINTK("%s: Not waiting for GPS Fix!\n", __func__);
#endif

	/* Switch-on green LED to signify sensor has a GPS fix */
	leds_set(LED_GREEN, true);

	while (1) {
		k_sleep(msg_interval);
		/* Build packet */
		if (build_packet(&pkt_buffer) < 0) {
			DBG_PRINTK("Couldn't build packet\n");
		}

		/* Send through LoRa */
		if (rn2483_lora_radio_tx((u8_t*)&pkt_buffer, sizeof(struct race_tracking_pkt))) {
			DBG_PRINTK("Couldn't send packet\n");
		}
	}
}

static int configure_rn2483(void)
{
	int err;

	/* Initialize the UART */
	err = rn2483_lora_init(CONFIG_UART_SAM0_SERCOM2_LABEL);
	if (err) {
		DBG_PRINTK("%s: Can't init RN2483 %d\n", __func__, err);
		return RACE_SENSOR_MNGR_LORA_DEVICE_FAILURE;
	}

	/* Pause mac layer */
	err = rn2483_lora_pause_mac();
	if (err) {
		DBG_PRINTK("%s: Can't pause mac layer %d\n", __func__, err);
		return RACE_SENSOR_MNGR_LORA_DEVICE_FAILURE;
	}

	/* Set spreading factor */
	err = rn2483_lora_radio_set_sf(LORA_SPREADING_FACTOR);
	if (err) {
		DBG_PRINTK("%s: Can't set spreading factor %d\n", __func__, err);
		return RACE_SENSOR_MNGR_LORA_DEVICE_FAILURE;
	}

	/* Set power output */
	err = rn2483_lora_radio_set_pwr(LORA_POWER_OUTPUT);
	if (err) {
		DBG_PRINTK("%s: Can't set power output %d\n", __func__, err);
		return RACE_SENSOR_MNGR_LORA_DEVICE_FAILURE;
	}

	return RACE_SENSOR_MNGR_SUCCESS;
}

static int configure_gps(void)
{
	int err;

	/* Initialize the gps */
	err = ubloxeva8m_init(CONFIG_I2C_SAM0_SERCOM3_LABEL);
	if (err) {
		DBG_PRINTK("%s: Can't initialize UBloxEVA8M %d\n", __func__, err);
		return RACE_SENSOR_MNGR_GPS_DEVICE_FAILURE;
	}

	/* Set callback function */
	ubloxeva8m_set_callback(gps_msg_callback);

	/* Start module */
	err = ubloxeva8m_start();
	if (err) {
		DBG_PRINTK("%s: Can't start GPS module %d\n", __func__, err);
		return RACE_SENSOR_MNGR_GPS_DEVICE_FAILURE;
	}

	/* Set the dynamic model used by the GPS */
	err = ubloxeva8m_set_dynamic_model(UBLOXEVA8M_DYNMODEL_AUTOMOTIVE);
	if (err) {
		DBG_PRINTK("%s: Can't set dynamic model %d\n", __func__, err);
		return RACE_SENSOR_MNGR_GPS_DEVICE_FAILURE;
	}

	return RACE_SENSOR_MNGR_SUCCESS;
}

static int update_pinmux(void)
{
	struct device *muxa;
	int err;

	muxa = device_get_binding(CONFIG_PINMUX_SAM0_A_LABEL);
	if (!muxa) {
		DBG_PRINTK("%s: Binding to pinmux failed\n", __func__);
		return HR_BINDING_FAILED;
	}

	/* Accelerometer INT1_XL */
	err = pinmux_pin_set(muxa, ACCEL_INT1_PIN, PINMUX_FUNC_A);
	if (err < 0) {
		DBG_PRINTK("%s: Cannot change pin function\n", __func__);
		return err;
	}

	/* Accelerometer INT2_XL */
	err = pinmux_pin_set(muxa, ACCEL_INT2_PIN, PINMUX_FUNC_A);
	if (err < 0) {
		DBG_PRINTK("%s: Cannot change pin function\n", __func__);
		return err;
	}

	return 0;
}

int race_sensor_mngr_init(void)
{
	int err;

	if (race_sensor_mngr.initialized) {
		return RACE_SENSOR_MNGR_SUCCESS;
	}

	err = update_pinmux();
	if (err < 0) {
		return err;
	}

	DBG_PRINTK("%s: Initializing RN2483\n", __func__);
	/* Configure the LoRa chip */
	err = configure_rn2483();
	if (err) {
		return err;
	}

	DBG_PRINTK("%s: Initializing UBloxEVA8M\n", __func__);
	/* Configure the GPS */
	err = configure_gps();
	if (err) {
		return err;
	}

	DBG_PRINTK("%s: Initializing Cadence\n", __func__);
	err = cadence_init(CONFIG_I2C_SAM0_SERCOM3_LABEL, ACCEL_INT_DEV, ACCEL_INT1_PIN);
	if (err < 0) {
		return err;
	}

	DBG_PRINTK("%s: Initializing Heart_Rate\n", __func__);
	err = hr_init(GPIO_HR_DEV, GPIO_HR_PIN);
	if (err < 0) {
		return err;
	}

	race_sensor_mngr.initialized = true;

	return RACE_SENSOR_MNGR_SUCCESS;
}

int race_sensor_mngr_start(void)
{
	if (!race_sensor_mngr.initialized) {
		return RACE_SENSOR_MNGR_NOT_INITIALIZED;
	}

	k_thread_start(race_sensor_mngr_thread_id);

	return RACE_SENSOR_MNGR_SUCCESS;
}

void race_sensor_mngr_set_msg_interval(int interval)
{
	msg_interval = K_MSEC(interval);
}

/* Thread definition for the RN2483 LoRa module */
K_THREAD_DEFINE(race_sensor_mngr_thread_id, RACE_SENSOR_MNGR_STACK_SIZE, race_sensor_mngr_thread, NULL, NULL, NULL, RACE_SENSOR_MNGR_PRIORITY, 0, K_FOREVER);
```

## src/race_sensor_manager.h
```c
/** 
 * @file race_sensor_manager.h
 * @brief Race Sensor Manager module
 *
 * The Race Sensor Manager module is responsible for periodically
 * performing the required acquisitions, creating and sending the
 * Race Tracking Packet containing the information about the competitor
 *
 * @author Léonard Bise
 * @date   Jul 23, 2018
 */
#ifndef SRC_RACE_SENSOR_MANAGER_H_
#define SRC_RACE_SENSOR_MANAGER_H_

#include <zephyr.h>

/**
 * Statuses of the race sensor manager
 */
#define RACE_SENSOR_MNGR_SUCCESS 0
#define RACE_SENSOR_MNGR_NOT_INITIALIZED -1
#define RACE_SENSOR_MNGR_LORA_DEVICE_FAILURE -2
#define RACE_SENSOR_MNGR_GPS_DEVICE_FAILURE -3
#define RACE_SENSOR_MNGR_ACCEL_DEVICE_FAILURE -4

/**
 * Initialze the race sensor manager
 * @return One of race sensor manager statuses
 */
int race_sensor_mngr_init(void);

/**
 * Starts the race sensor manager
 */
int race_sensor_mngr_start(void);

/**
 * Sets the heart rate sent in the packets
 * @param heart_rate Heart Rate
 */
void race_sensor_mngr_set_heart_rate(u8_t heart_rate);

/**
 * Sets the cadence sent in the packets
 * @param cadence Cadence
 */
void race_sensor_mngr_set_cadence(u8_t cadence);

/**
 * Sets the message interval
 * @param interval Interval in ms
 */
void race_sensor_mngr_set_msg_interval(int interval);

#endif /* SRC_RACE_SENSOR_MANAGER_H_ */
```

## src/race_sensor_shell.c
```c
/** 
 * @file race_sensor_shell.c
 * @brief Module description
 *
 * Detailed module description
 *
 * @author Léonard Bise
 * @date   Jul 29, 2018
 */

#include "race_sensor_shell.h"

#include <zephyr.h>
#include <stdlib.h>
#include <stdio.h>

#include "RN2483_lora.h"
#include "race_sensor_manager.h"
#include "cadence.h"
#include "LSM303AGR.h"

int race_sensor_shell_set_lora_sf(int argc, char *argv[]) {
	int err;

	if (argc != 2) {
		printk("Wrong number of arguments\n");
		return -EINVAL;
	}

	err = rn2483_lora_radio_set_sf(argv[1]);
	if (err < 0) {
		printk("Couldn't set spreading factor %s : %d\n", argv[1], err);
		return err;
	} else {
		printk("Set LoRa spreading factor %s successfully\n", argv[1]);
	}

	return 0;
}

int race_sensor_shell_set_lora_pwr(int argc, char *argv[]) {
	int err;
	s8_t pwr;
	char *end;

	if (argc != 2) {
		printk("Wrong number of arguments\n");
		return -EINVAL;
	}

	pwr = strtol(argv[1], &end, 0);

	err = rn2483_lora_radio_set_pwr(pwr);
	if (err < 0) {
		printk("Couldn't set power output %d : %d\n", pwr, err);
		return err;
	} else {
		printk("Set LoRa power output %d successfully\n", pwr);
	}

	return 0;
}

int race_sensor_shell_set_msg_interval(int argc, char *argv[]) {
	int interval;
	char *end;

	if (argc != 2) {
		printk("Wrong number of arguments\n");
		return -EINVAL;
	}

	interval = strtol(argv[1], &end, 0);
	race_sensor_mngr_set_msg_interval(interval);

	return 0;
}

int race_sensor_shell_cadence_samples(int argc, char *argv[])
{
	cadence_print();
	return 0;
}

int race_sensor_shell_cadence_reset(int argc, char *argv[])
{
	cadence_reset_samples();
	return 0;
}

int race_sensor_shell_cadence_scale(int argc, char *argv[])
{
	int16_t value;
	double scaled = 0;
	char buffer[56];

	if (argc < 2) {
		printk("Wrong number of arguments\n");
		return -EINVAL;
	}

	value = strtol(argv[1], NULL, 0);
	scaled = lsm303agr_get_scaled_value(value);

	snprintf(buffer, 56, "value=%d scaled=%f\n", value, scaled);
	printk("%s", buffer);

	return 0;
}
```

## src/race_sensor_shell.h
```c
/** 
 * @file race_sensor_shell.h
 * @brief Module description
 *
 * Detailed module description
 *
 * @author Léonard Bise
 * @date   Jul 29, 2018
 */
#ifndef SRC_RACE_SENSOR_SHELL_H_
#define SRC_RACE_SENSOR_SHELL_H_

/**
 * Set the LoRa spreading factor
 * @param argc Number of arguments
 * @param argv Arguments array
 * @return 0 on success, negative errno code on failure
 */
int race_sensor_shell_set_lora_sf(int argc, char *argv[]);

/**
 * Set the LoRa power output
 * @param argc Number of arguments
 * @param argv Arguments array
 * @return 0 on success, negative errno code on failure
 */
int race_sensor_shell_set_lora_pwr(int argc, char *argv[]);

/**
 * Sets the interval between two messages
 * @param argc Number of arguments
 * @param argv Arguments array
 * @return 0 on success, negative errno code on failure
 */
int race_sensor_shell_set_msg_interval(int argc, char *argv[]);

int race_sensor_shell_cadence_samples(int argc, char *argv[]);

int race_sensor_shell_cadence_reset(int argc, char *argv[]);

int race_sensor_shell_cadence_scale(int argc, char *argv[]);

#endif /* SRC_RACE_SENSOR_SHELL_H_ */
```

## src/sensor_config.h
```c
/** 
 * @file sensor_config.h
 * @brief RaceSensor configuration
 *
 * This file provides the configuration of the RaceSensor
 *
 * @author Léonard Bise
 * @date   Jul 23, 2018
 */
#ifndef SRC_SENSOR_CONFIG_H_
#define SRC_SENSOR_CONFIG_H_

/* ************************************************************************* */
/* General								     */
/* ************************************************************************* */
/**
 * ID of the sensor
 */
#define SENSOR_ID 0x1234

/* ************************************************************************* */
/* GPIO									     */
/* ************************************************************************* */
/**
 * Heart Rate connected on PA7 GPIO
 */
/* TODO: Something is wrong because the pin on which the HR is supposed
 * to be is PA11 but it doesn't work... Only setting PB11 works */
#define GPIO_HR_DEV CONFIG_GPIO_SAM0_PORTB_LABEL
#define GPIO_HR_PIN 11
//#define GPIO_HR_DEV CONFIG_GPIO_SAM0_PORTA_LABEL
//#define GPIO_HR_PIN 8
/**
 * Accelerometer interrupts connected on PA20 and PA21
 */
#define ACCEL_INT_DEV CONFIG_GPIO_SAM0_PORTA_LABEL
#define ACCEL_INT1_PIN 21
#define ACCEL_INT2_PIN 20

/* ************************************************************************* */
/* Accelerometer							     */
/* ************************************************************************* */
/* From data sheet: FS = 2g -> 1 LSB = 16 mg
 * 1g = 62 */
#define ACCELEROMETER_Z_THRESHOLD 62
#define ACCELEROMETER_INT_DURATION 0

/* ************************************************************************* */
/* LoRa									     */
/* ************************************************************************* */
/**
 * LoRa spreading factor
 * (Between sf7 and sf12)
 */
#define LORA_SPREADING_FACTOR "sf12"

/**
 * LoRa power output
 */
#define LORA_POWER_OUTPUT 1

#endif /* SRC_SENSOR_CONFIG_H_ */
```
